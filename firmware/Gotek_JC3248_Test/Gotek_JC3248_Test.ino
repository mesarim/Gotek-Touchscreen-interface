// ============================================================================
// Gotek_JC3248_Test.ino  —  HARDWARE DIAGNOSTIC for the Guition JC3248W535(C)
// ----------------------------------------------------------------------------
// Purpose: chase the "boots once then freezes after the loader" reports on
// newer JC3248W535C boards. Strips 5.9.4 down to just the hardware bring-up and
// reports what esptool-style board ID data we can read from the chip itself
// (model / silicon revision / PSRAM / flash / MAC), then runs selectable tests.
//
// Two suspects, both testable here: (1) PSRAM init failing on a new die rev
// (the real firmware's framebuffer is a 307KB ps_malloc with NO null-check, so
// a PSRAM failure = silent freeze on the first draw); (2) a timing / digitizer
// conflict — the AXS15231B is ONE chip doing both the QSPI display and the I2C
// touch (0x3B), so bus/clock timing can upset it.
//
// EVERYTHING here draws from INTERNAL RAM only (strip blits), so the panel still
// shows a result even if PSRAM is dead. Full detail goes to Serial.
//
// ARDUINO IDE BOARD SETTINGS (important):
//   Board: ESP32S3 Dev Module
//   USB CDC On Boot: ENABLED   <-- so the Serial Monitor works (firmware has it OFF)
//   USB Mode: USB-OTG (TinyUSB) ... or Hardware CDC, either is fine for serial
//   PSRAM: OPI PSRAM   |   Flash: 16MB (128Mb) QIO 80MHz   |   CPU: 240MHz
//   (this mirrors the real firmware so we reproduce the same PSRAM path)
//
// Put a text file  config.test  on the SD root to pick the mode + clocks.
// ============================================================================

#include <Arduino.h>
#include <FS.h>
#include <SD_MMC.h>
#include <Wire.h>
#include "driver/spi_master.h"
#include "esp_lcd_panel_io.h"
#include "esp_lcd_panel_vendor.h"
#include "esp_lcd_panel_ops.h"
#include "esp_lcd_panel_interface.h"
#include "esp_lcd_axs15231b.h"
#include "esp_chip_info.h"
#include "esp_heap_caps.h"

extern "C" { void* ps_malloc(size_t); }

// ---- pins (identical to Gotek_JC3248) ----
#define LCD_WIDTH  320
#define LCD_HEIGHT 480
#define LCD_PIN_CS 45
#define LCD_PIN_CLK 47
#define LCD_PIN_MOSI 21
#define LCD_PIN_MISO 48
#define LCD_PIN_D2 40
#define LCD_PIN_D3 39
#define LCD_PIN_BL 1
#define TOUCH_SDA 4
#define TOUCH_SCL 8
#define TOUCH_ADDR 0x3B
#define SD_CLK 12
#define SD_CMD 11
#define SD_D0 13
#define ROWS_PER_STRIP 16

#define C_BLACK 0x0000
#define C_WHITE 0xFFFF
#define C_RED   0xF800
#define C_GREEN 0x07E0
#define C_BLUE  0x001F
#define C_YELLOW 0xFFE0
#define C_ORANGE 0xFD20
#define C_GRAY  0x8410
static inline uint16_t sw(uint16_t c){return (uint16_t)((c>>8)|(c<<8));} // panel wants byte-swapped RGB565

// ---- config.test values (defaults mirror the shipping firmware) ----
static String cfgMode = "ALL";      // INFO | PSRAM | DISPLAY | TOUCH | ALL
static int cfgCpu     = 240;        // 240 | 160 | 80   (timing test)
static int cfgLcd     = 50;         // QSPI panel clock MHz (firmware uses 50)
static int cfgTouchKhz= 400;        // I2C digitizer clock kHz (firmware 400)
static int cfgSdKhz   = 20000;      // SDIO clock kHz
static int cfgLoop    = 1;          // keep re-running (great for watching TOUCH)
static int cfgHoldMs  = 4000;       // pause between loops

static const axs15231b_lcd_init_cmd_t lcd_init_cmds[] = {
  {0xBB,(uint8_t[]){0x00,0x00,0x00,0x00,0x00,0x00,0x5A,0xA5},8,0},
  {0xA0,(uint8_t[]){0xC0,0x10,0x00,0x02,0x00,0x00,0x04,0x3F,0x20,0x05,0x3F,0x3F,0x00,0x00,0x00,0x00,0x00},17,0},
  {0xA2,(uint8_t[]){0x30,0x3C,0x24,0x14,0xD0,0x20,0xFF,0xE0,0x40,0x19,0x80,0x80,0x80,0x20,0xf9,0x10,0x02,0xff,0xff,0xF0,0x90,0x01,0x32,0xA0,0x91,0xE0,0x20,0x7F,0xFF,0x00,0x5A},31,0},
  {0xD0,(uint8_t[]){0xE0,0x40,0x51,0x24,0x08,0x05,0x10,0x01,0x20,0x15,0x42,0xC2,0x22,0x22,0xAA,0x03,0x10,0x12,0x60,0x14,0x1E,0x51,0x15,0x00,0x8A,0x20,0x00,0x03,0x3A,0x12},30,0},
  {0xA3,(uint8_t[]){0xA0,0x06,0xAa,0x00,0x08,0x02,0x0A,0x04,0x04,0x04,0x04,0x04,0x04,0x04,0x04,0x04,0x04,0x04,0x04,0x00,0x55,0x55},22,0},
  {0xC1,(uint8_t[]){0x31,0x04,0x02,0x02,0x71,0x05,0x24,0x55,0x02,0x00,0x41,0x00,0x53,0xFF,0xFF,0xFF,0x4F,0x52,0x00,0x4F,0x52,0x00,0x45,0x3B,0x0B,0x02,0x0d,0x00,0xFF,0x40},30,0},
  {0xC3,(uint8_t[]){0x00,0x00,0x00,0x50,0x03,0x00,0x00,0x00,0x01,0x80,0x01},11,0},
  {0xC4,(uint8_t[]){0x00,0x24,0x33,0x80,0x00,0xea,0x64,0x32,0xC8,0x64,0xC8,0x32,0x90,0x90,0x11,0x06,0xDC,0xFA,0x00,0x00,0x80,0xFE,0x10,0x10,0x00,0x0A,0x0A,0x44,0x50},29,0},
  {0xC5,(uint8_t[]){0x18,0x00,0x00,0x03,0xFE,0x3A,0x4A,0x20,0x30,0x10,0x88,0xDE,0x0D,0x08,0x0F,0x0F,0x01,0x3A,0x4A,0x20,0x10,0x10,0x00},23,0},
  {0xC6,(uint8_t[]){0x05,0x0A,0x05,0x0A,0x00,0xE0,0x2E,0x0B,0x12,0x22,0x12,0x22,0x01,0x03,0x00,0x3F,0x6A,0x18,0xC8,0x22},20,0},
  {0xC7,(uint8_t[]){0x50,0x32,0x28,0x00,0xa2,0x80,0x8f,0x00,0x80,0xff,0x07,0x11,0x9c,0x67,0xff,0x24,0x0c,0x0d,0x0e,0x0f},20,0},
  {0xC9,(uint8_t[]){0x33,0x44,0x44,0x01},4,0},
  {0xCF,(uint8_t[]){0x2C,0x1E,0x88,0x58,0x13,0x18,0x56,0x18,0x1E,0x68,0x88,0x00,0x65,0x09,0x22,0xC4,0x0C,0x77,0x22,0x44,0xAA,0x55,0x08,0x08,0x12,0xA0,0x08},27,0},
  {0xD5,(uint8_t[]){0x40,0x8E,0x8D,0x01,0x35,0x04,0x92,0x74,0x04,0x92,0x74,0x04,0x08,0x6A,0x04,0x46,0x03,0x03,0x03,0x03,0x82,0x01,0x03,0x00,0xE0,0x51,0xA1,0x00,0x00,0x00},30,0},
  {0xD6,(uint8_t[]){0x10,0x32,0x54,0x76,0x98,0xBA,0xDC,0xFE,0x93,0x00,0x01,0x83,0x07,0x07,0x00,0x07,0x07,0x00,0x03,0x03,0x03,0x03,0x03,0x03,0x00,0x84,0x00,0x20,0x01,0x00},30,0},
  {0xD7,(uint8_t[]){0x03,0x01,0x0b,0x09,0x0f,0x0d,0x1E,0x1F,0x18,0x1d,0x1f,0x19,0x40,0x8E,0x04,0x00,0x20,0xA0,0x1F},19,0},
  {0xD8,(uint8_t[]){0x02,0x00,0x0a,0x08,0x0e,0x0c,0x1E,0x1F,0x18,0x1d,0x1f,0x19},12,0},
  {0xD9,(uint8_t[]){0x1F,0x1F,0x1F,0x1F,0x1F,0x1F,0x1F,0x1F,0x1F,0x1F,0x1F,0x1F},12,0},
  {0xDD,(uint8_t[]){0x1F,0x1F,0x1F,0x1F,0x1F,0x1F,0x1F,0x1F,0x1F,0x1F,0x1F,0x1F},12,0},
  {0xDF,(uint8_t[]){0x44,0x73,0x4B,0x69,0x00,0x0A,0x02,0x90},8,0},
  {0xE0,(uint8_t[]){0x3B,0x28,0x10,0x16,0x0c,0x06,0x11,0x28,0x5c,0x21,0x0D,0x35,0x13,0x2C,0x33,0x28,0x0D},17,0},
  {0xE1,(uint8_t[]){0x37,0x28,0x10,0x16,0x0b,0x06,0x11,0x28,0x5C,0x21,0x0D,0x35,0x14,0x2C,0x33,0x28,0x0F},17,0},
  {0xE2,(uint8_t[]){0x3B,0x07,0x12,0x18,0x0E,0x0D,0x17,0x35,0x44,0x32,0x0C,0x14,0x14,0x36,0x3A,0x2F,0x0D},17,0},
  {0xE3,(uint8_t[]){0x37,0x07,0x12,0x18,0x0E,0x0D,0x17,0x35,0x44,0x32,0x0C,0x14,0x14,0x36,0x32,0x2F,0x0F},17,0},
  {0xE4,(uint8_t[]){0x3B,0x07,0x12,0x18,0x0E,0x0D,0x17,0x39,0x44,0x2E,0x0C,0x14,0x14,0x36,0x3A,0x2F,0x0D},17,0},
  {0xE5,(uint8_t[]){0x37,0x07,0x12,0x18,0x0E,0x0D,0x17,0x39,0x44,0x2E,0x0C,0x14,0x14,0x36,0x3A,0x2F,0x0F},17,0},
  {0xA4,(uint8_t[]){0x85,0x85,0x95,0x82,0xAF,0xAA,0xAA,0x80,0x10,0x30,0x40,0x40,0x20,0xFF,0x60,0x30},16,0},
  {0xA4,(uint8_t[]){0x85,0x85,0x95,0x85},4,0},
  {0xBB,(uint8_t[]){0x00,0x00,0x00,0x00,0x00,0x00,0x00,0x00},8,0},
  {0x13,(uint8_t[]){0x00},0,0},
  {0x11,(uint8_t[]){0x00},0,120},
  {0x29,(uint8_t[]){0x00},0,20},
  {0x2C,(uint8_t[]){0x00,0x00,0x00,0x00},4,0},
};

// ════════════════════════════════════════════════════════════════════════════
// FONT 6×8
// ════════════════════════════════════════════════════════════════════════════
static const uint8_t font6x8[95][6] PROGMEM = {
  {0x00,0x00,0x00,0x00,0x00,0x00},{0x00,0x00,0x4F,0x00,0x00,0x00},{0x00,0x07,0x00,0x07,0x00,0x00},
  {0x14,0x7F,0x14,0x7F,0x14,0x00},{0x24,0x2A,0x7F,0x2A,0x12,0x00},{0x62,0x64,0x08,0x13,0x23,0x00},
  {0x36,0x49,0x49,0x36,0x50,0x00},{0x00,0x04,0x03,0x00,0x00,0x00},{0x00,0x1C,0x22,0x41,0x00,0x00},
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  {0x00,0x41,0x36,0x08,0x00,0x00},{0x08,0x04,0x08,0x10,0x08,0x00},
};

// ════════════════════════════════════════════════════════════════════════════
// DISPLAY + FRAMEBUFFER (Dimi's proven code)
// ════════════════════════════════════════════════════════════════════════════



static esp_lcd_panel_io_handle_t io_handle = NULL;
static esp_lcd_panel_handle_t   panel_handle = NULL;
static uint16_t* strip = NULL;      // ROWS_PER_STRIP * LCD_WIDTH, INTERNAL DMA RAM (no PSRAM)
static bool g_disp = false;

// ---- panel bring-up (NO PSRAM framebuffer — strip blits only) ----
static bool panelInit(int lcdMhz){
  strip = (uint16_t*)heap_caps_malloc(LCD_WIDTH*ROWS_PER_STRIP*2, MALLOC_CAP_DMA|MALLOC_CAP_INTERNAL);
  if(!strip){ Serial.println("[LCD] strip alloc FAILED (internal RAM)"); return false; }
  spi_bus_config_t buscfg={};
  buscfg.data0_io_num=LCD_PIN_MOSI; buscfg.data1_io_num=LCD_PIN_MISO;
  buscfg.sclk_io_num=LCD_PIN_CLK;   buscfg.data2_io_num=LCD_PIN_D2; buscfg.data3_io_num=LCD_PIN_D3;
  buscfg.max_transfer_sz=LCD_WIDTH*ROWS_PER_STRIP*2;
  if(spi_bus_initialize(SPI2_HOST,&buscfg,SPI_DMA_CH_AUTO)!=ESP_OK){ Serial.println("[LCD] spi_bus_initialize FAILED"); return false; }
  esp_lcd_panel_io_spi_config_t io_config={};
  io_config.cs_gpio_num=LCD_PIN_CS; io_config.dc_gpio_num=-1; io_config.spi_mode=3;
  io_config.pclk_hz=(uint32_t)lcdMhz*1000000; io_config.trans_queue_depth=1;
  io_config.lcd_cmd_bits=32; io_config.lcd_param_bits=8; io_config.flags.quad_mode=true;
  if(esp_lcd_new_panel_io_spi((esp_lcd_spi_bus_handle_t)SPI2_HOST,&io_config,&io_handle)!=ESP_OK){ Serial.println("[LCD] panel_io FAILED"); return false; }
  axs15231b_vendor_config_t vc={}; vc.init_cmds=lcd_init_cmds;
  vc.init_cmds_size=sizeof(lcd_init_cmds)/sizeof(lcd_init_cmds[0]); vc.flags.use_qspi_interface=1;
  esp_lcd_panel_dev_config_t pc={}; pc.reset_gpio_num=-1;
  pc.rgb_ele_order=LCD_RGB_ELEMENT_ORDER_RGB; pc.bits_per_pixel=16; pc.vendor_config=&vc;
  if(esp_lcd_new_panel_axs15231b(io_handle,&pc,&panel_handle)!=ESP_OK){ Serial.println("[LCD] new_panel FAILED"); return false; }
  esp_lcd_panel_reset(panel_handle); delay(100);
  esp_lcd_panel_init(panel_handle);  delay(200);
  ledcAttach(LCD_PIN_BL,5000,8); ledcWrite(LCD_PIN_BL,200);
  return true;
}
static void fillRect(int x,int y,int w,int h,uint16_t color){
  if(!g_disp||!panel_handle||!strip) return;
  if(x<0)x=0; if(y<0)y=0; if(x+w>LCD_WIDTH)w=LCD_WIDTH-x; if(y+h>LCD_HEIGHT)h=LCD_HEIGHT-y;
  uint16_t c=sw(color);
  for(int sy=y; sy<y+h; sy+=ROWS_PER_STRIP){
    int rows=min(ROWS_PER_STRIP,y+h-sy);
    for(int i=0;i<w*rows;i++) strip[i]=c;
    esp_lcd_panel_draw_bitmap(panel_handle,x,sy,x+w,sy+rows,strip);
  }
}
static void screenFill(uint16_t c){ fillRect(0,0,LCD_WIDTH,LCD_HEIGHT,c); }
// Status band idx from top: draws a coloured bar; frac (0..1) fills that fraction green over red.
static void band(int idx,uint16_t color){
  const int H=54,G=10,X=14,W=LCD_WIDTH-28; int y=14+idx*(H+G);
  if(y+H>LCD_HEIGHT) return; fillRect(X,y,W,H,color);
}
static void bandFrac(int idx,float frac,uint16_t ok,uint16_t bad){
  const int H=54,G=10,X=14,W=LCD_WIDTH-28; int y=14+idx*(H+G);
  if(y+H>LCD_HEIGHT) return;
  int wok=(int)(W*frac); fillRect(X,y,wok,H,ok); fillRect(X+wok,y,W-wok,H,bad);
}

// ---- board ID dump (what esptool would read, straight off the chip) ----
static void dumpInfo(){
  esp_chip_info_t ci; esp_chip_info(&ci);
  uint64_t mac=ESP.getEfuseMac();
  Serial.println(F("---- BOARD ID ----"));
  Serial.printf("Chip model     : %s\n", ESP.getChipModel());
  Serial.printf("Silicon rev    : v%d.%d   (esp_chip_info.revision=%d)\n", ci.revision/100, ci.revision%100, ci.revision);
  Serial.printf("Cores          : %d\n", ci.cores);
  Serial.printf("CPU freq       : %u MHz\n", getCpuFrequencyMhz());
  Serial.printf("Features       : %s%s%s%s\n",
                (ci.features&CHIP_FEATURE_WIFI_BGN)?"WiFi ":"",
                (ci.features&CHIP_FEATURE_BLE)?"BLE ":"",
                (ci.features&CHIP_FEATURE_BT)?"BT ":"",
                (ci.features&CHIP_FEATURE_EMB_PSRAM)?"EMB-PSRAM ":"");
  Serial.printf("Flash size     : %u MB\n", (unsigned)(ESP.getFlashChipSize()/(1024*1024)));
  Serial.printf("Flash speed    : %u MHz\n", (unsigned)(ESP.getFlashChipSpeed()/1000000));
  Serial.printf("Flash mode     : %d (0=QIO 1=QOUT 2=DIO 3=DOUT)\n", (int)ESP.getFlashChipMode());
  Serial.printf("PSRAM found    : %s\n", psramFound()?"YES":"*** NO ***");
  Serial.printf("PSRAM size     : %u KB (free %u KB)\n", (unsigned)(ESP.getPsramSize()/1024), (unsigned)(ESP.getFreePsram()/1024));
  Serial.printf("Internal heap  : %u KB free\n", (unsigned)(ESP.getFreeHeap()/1024));
  Serial.printf("MAC            : %02X:%02X:%02X:%02X:%02X:%02X\n",
                (uint8_t)(mac>>40),(uint8_t)(mac>>32),(uint8_t)(mac>>24),(uint8_t)(mac>>16),(uint8_t)(mac>>8),(uint8_t)mac);
  Serial.printf("SDK            : %s\n", ESP.getSdkVersion());
}

// ---- PSRAM test: alloc + write/verify a walking pattern across the whole part ----
static bool testPsram(float* fracOut){
  Serial.println(F("---- PSRAM TEST ----"));
  if(!psramFound()){ Serial.println("PSRAM not initialised -> ps_malloc returns NULL -> firmware would FREEZE here."); if(fracOut)*fracOut=0; return false; }
  size_t total=ESP.getPsramSize(); size_t want=(size_t)(total*0.9); // leave headroom
  Serial.printf("Allocating %u KB in PSRAM...\n",(unsigned)(want/1024));
  const size_t CH=256*1024; size_t done=0, bad=0, checked=0;
  while(done<want){
    size_t n=min(CH,want-done);
    uint32_t* p=(uint32_t*)ps_malloc(n);
    if(!p){ Serial.printf("  ps_malloc FAILED at +%u KB\n",(unsigned)(done/1024)); break; }
    size_t words=n/4;
    for(size_t i=0;i<words;i++) p[i]=(uint32_t)(0xA5A50000u ^ (done+i));
    for(size_t i=0;i<words;i++){ if(p[i]!=(uint32_t)(0xA5A50000u ^ (done+i))) bad++; checked++; }
    free(p); done+=n;
    if((done%(1024*1024))==0) Serial.printf("  ...%u MB ok\n",(unsigned)(done/(1024*1024)));
  }
  Serial.printf("PSRAM verified %u KB, %u word errors -> %s\n",(unsigned)(done/1024),(unsigned)bad, (bad==0&&done>=want)?"PASS":"*** FAIL ***");
  if(fracOut)*fracOut = total? (float)done/(float)total : 0;
  return (bad==0 && done>=want);
}

// ---- I2C bus scan: which addresses ACK (catches a DIFFERENT touch chip, e.g. GT911) ----
static void i2cScan(){
  Serial.println("I2C bus scan    :");
  int n=0;
  for(uint8_t a=0x08;a<0x78;a++){
    Wire.beginTransmission(a);
    if(Wire.endTransmission()==0){
      const char* note = (a==0x3B)?"  <- AXS15231B (expected)" : (a==0x5D||a==0x14)?"  <- GT911?" : "";
      Serial.printf("   ACK 0x%02X%s\n",a,note); n++;
    }
  }
  if(!n) Serial.println("   (nothing ACKed - check SDA=4 SCL=8, power)");
}

// ---- digitizer test: bus scan + full raw-byte dump + coordinate RANGE + TOUCHCAL ----
static bool testTouch(int khz,int seconds){
  Serial.printf("---- TOUCH / DIGITIZER TEST @ %d kHz ----\n",khz);
  Wire.end(); Wire.begin(TOUCH_SDA,TOUCH_SCL,(uint32_t)khz*1000);
  i2cScan();
  Wire.beginTransmission(TOUCH_ADDR); uint8_t ack=Wire.endTransmission();
  Serial.printf("I2C probe 0x3B  : %s\n", ack==0?"ACK (present)":"*** NO ACK ***");
  if(ack!=0) return false;
  Serial.println("Touch the FOUR CORNERS then the CENTRE - watch the raw min/max below:");
  uint32_t t0=millis(); int frames=0,valid=0,wide=0,nak=0;
  uint16_t xmin=0xFFFF,xmax=0,ymin=0xFFFF,ymax=0;
  while(millis()-t0 < (uint32_t)seconds*1000){
    uint8_t cmd[11]={0xb5,0xab,0xa5,0x5a,0x00,0x00,0x00,0x08,0x00,0x00,0x00};
    Wire.beginTransmission(TOUCH_ADDR); Wire.write(cmd,11);
    if(Wire.endTransmission()!=0){ nak++; delay(20); continue; }
    if(Wire.requestFrom((int)TOUCH_ADDR,8)!=8){ nak++; delay(20); continue; }
    uint8_t b[8]; for(int i=0;i<8;i++) b[i]=Wire.read();
    frames++;
    if(b[0]==0 && b[1]){ // REAL touch only (vendor rule b[0]==0 && b[1]!=0; rejects 0xCA/0xFF idle fill)
      uint16_t rx=((b[2]&0x0F)<<8)|b[3], ry=((b[4]&0x0F)<<8)|b[5];
      bool inpanel=(rx<LCD_WIDTH && ry<LCD_HEIGHT);
      if(inpanel) valid++; else wide++;
      if(rx<xmin)xmin=rx; if(rx>xmax)xmax=rx; if(ry<ymin)ymin=ry; if(ry>ymax)ymax=ry;
      Serial.printf("  raw x=%4u y=%4u  bytes= %02X %02X %02X %02X %02X %02X %02X %02X  %s\n",
        rx,ry, b[0],b[1],b[2],b[3],b[4],b[5],b[6],b[7], inpanel?"in-panel":"WIDE(>panel)");
    }
    delay(15);
  }
  Serial.printf("Frames=%d valid=%d wide=%d naks=%d\n",frames,valid,wide,nak);
  if(xmax) Serial.printf("REAL-touch range: X %u..%u   Y %u..%u   (0xCA/0xFF idle frames excluded)\n",xmin,xmax,ymin,ymax);
  Serial.println("Real touches should sit INSIDE 320x480. The bug was NOT a wide digitizer:");
  Serial.println("the AXS15231B idle/no-touch frames come back as 0xCA-fill or 0xFF-fill with");
  Serial.println("b[1]!=0, and the old code read them as phantom touches. The fix is to require");
  Serial.println("b[0]==0 && b[1]!=0 (vendor rule) - see the ghost2-tfix firmware.");
  return (nak==0);   // a healthy digitizer never NAKs the read
}

static void runOnce(){
  Serial.printf("\n===== RUN  MODE=%s  CPU=%uMHz  LCD=%dMHz  TOUCH=%dkHz =====\n",cfgMode.c_str(),getCpuFrequencyMhz(),cfgLcd,cfgTouchKhz);
  if(g_disp) screenFill(C_BLUE);
  dumpInfo();
  bool doAll=(cfgMode=="ALL"), doInfo=(cfgMode=="INFO");
  float pf=0; bool psramOk=true, touchOk=true;
  if(doAll||cfgMode=="PSRAM"){ psramOk=testPsram(&pf); if(g_disp) bandFrac(0,pf,C_GREEN,C_RED); }
  if(doAll||cfgMode=="DISPLAY"){
    Serial.println(F("---- DISPLAY TEST ----  (R,G,B,W sweep)"));
    if(g_disp){ const uint16_t sweep[4]={C_RED,C_GREEN,C_BLUE,C_WHITE}; for(int k=0;k<4;k++){ screenFill(sweep[k]); delay(400);} }
    Serial.println("If you saw red/green/blue/white, the QSPI panel is good.");
  }
  if(doAll||cfgMode=="TOUCH"){ touchOk=testTouch(cfgTouchKhz, cfgLoop?6:10); if(g_disp) band(1, touchOk?C_GREEN:C_RED); }
  if(g_disp && !doInfo && !((doAll||cfgMode=="DISPLAY"))){
    // if we didn't run the colour sweep, still paint an overall verdict background
  }
  if(g_disp){ // overall verdict strip at the bottom
    uint16_t v = (psramOk&&touchOk)? C_GREEN : C_RED;
    band(2, doInfo? C_GRAY : v);
  }
  Serial.printf("===== RESULT: PSRAM %s | TOUCH %s =====\n", psramOk?"PASS":"FAIL", touchOk?"PASS":"FAIL");
}

static bool mountSD(int khz){
  SD_MMC.setPins(SD_CLK,SD_CMD,SD_D0);
  return SD_MMC.begin("/sdcard", true, false, khz); // 1-bit mode
}
static void parseCfg(const String& raw){
  int i=0; while(i<(int)raw.length()){
    int e=raw.indexOf('\n',i); if(e<0)e=raw.length();
    String ln=raw.substring(i,e); i=e+1; ln.trim();
    if(!ln.length()||ln[0]=='#') continue;
    int eq=ln.indexOf('='); if(eq<0) continue;
    String k=ln.substring(0,eq); k.trim(); k.toUpperCase();
    String v=ln.substring(eq+1); v.trim();
    if(k=="MODE"){ v.toUpperCase(); cfgMode=v; }
    else if(k=="CPU_MHZ") cfgCpu=v.toInt();
    else if(k=="LCD_MHZ") cfgLcd=v.toInt();
    else if(k=="TOUCH_KHZ") cfgTouchKhz=v.toInt();
    else if(k=="SD_KHZ") cfgSdKhz=v.toInt();
    else if(k=="LOOP") cfgLoop=(v=="1"||v.equalsIgnoreCase("ON"))?1:0;
    else if(k=="HOLD_MS") cfgHoldMs=v.toInt();
  }
}

void setup(){
  Serial.begin(115200);
  uint32_t t0=millis(); while(!Serial && millis()-t0<1500) delay(10); delay(300);
  Serial.println(F("\n\n############################################"));
  Serial.println(F("#  GTi JC3248 DIAGNOSTIC  (config.test)     #"));
  Serial.println(F("############################################"));

  bool sd=mountSD(20000);
  Serial.printf("SD mount       : %s\n", sd?"OK":"*** no card / mount failed ***");
  if(sd){
    File f=SD_MMC.open("/config.test","r");
    if(f){ String raw; while(f.available()) raw+=(char)f.read(); f.close(); parseCfg(raw); Serial.println("config.test loaded."); }
    else Serial.println("no /config.test -> using defaults (MODE=ALL).");
  }
  if(cfgCpu==240||cfgCpu==160||cfgCpu==80){ setCpuFrequencyMhz(cfgCpu); }
  Serial.printf("Applied        : MODE=%s CPU=%uMHz LCD=%dMHz TOUCH=%dkHz SD=%dkHz LOOP=%d\n",
                cfgMode.c_str(),getCpuFrequencyMhz(),cfgLcd,cfgTouchKhz,cfgSdKhz,cfgLoop);

  g_disp = panelInit(cfgLcd);
  Serial.printf("Panel init     : %s\n", g_disp?"OK":"*** FAILED (see log) ***");
  if(g_disp) screenFill(C_BLACK);

  runOnce();
}

void loop(){
  if(!cfgLoop){
    // idle: gentle blink of the backlight so you know it's alive & not frozen
    static bool on=true; if(g_disp){ ledcWrite(LCD_PIN_BL,on?200:40);} on=!on; delay(700); return;
  }
  delay(cfgHoldMs);
  runOnce();
}
