// aa_text.h - the anti-aliased screen font (A600-aa1): decoding a text, measuring it, cutting it to a width, and the colour of
// one edge pixel. Pure functions, no Arduino types: tools/test_aa_text.sh builds and runs them on the PC. The glyphs themselves are
// in aa_font_data.h (generated by tools/gen_aa_font.py).
#pragma once
#include <stdint.h>
#ifndef PROGMEM
#define PROGMEM
#endif

// One glyph: its ink is w x h pixels at (dx, dy) from the pen (dy from the top of the text box), the pen moves on by adv.
struct AaGlyph { uint32_t off; uint8_t w, h; int8_t dx, dy; uint8_t adv; };
// One size: box is the height of the text box (16 / 24 / 32, the box of the pixel font at 2x / 3x / 4x).
struct AaFont { const uint8_t* bits; const AaGlyph* glyphs; uint8_t box; };

#define AA_GLYPHS 191   // ASCII 32..126, then Latin-1 160..255

// The next character of s from byte *i on. UTF-8 up to U+07FF is decoded; a lone byte 0x80..0xFF is taken as Latin-1 (old SD names);
// anything the font has no glyph for comes back as '?' (a longer UTF-8 sequence counts as one '?').
inline uint16_t aaNext(const char* s, int* i) {
  const uint8_t c = (uint8_t)s[*i];
  if (c < 0x80) { (*i)++; return c; }
  int n = c >= 0xF0 ? 4 : c >= 0xE0 ? 3 : c >= 0xC0 ? 2 : 1;
  for (int k = 1; k < n; k++) if (((uint8_t)s[*i + k] & 0xC0) != 0x80) { n = 1; break; }   // not a sequence: a Latin-1 byte
  if (n == 1) { (*i)++; return c; }
  uint16_t cp = '?';
  if (n == 2) cp = (uint16_t)((c & 0x1F) << 6 | ((uint8_t)s[*i + 1] & 0x3F));
  *i += n;
  return cp;
}

// The glyph index of a code point; '?' for what the font does not have.
inline int aaIndex(uint16_t cp) {
  if (cp >= 32 && cp <= 126) return cp - 32;
  if (cp >= 160 && cp <= 255) return 95 + (cp - 160);
  return '?' - 32;
}

// The coverage (0..15) of pixel (x, y) of glyph g.
inline uint8_t aaCoverage(const uint8_t* bits, const AaGlyph& g, int x, int y) {
  const uint32_t n = (uint32_t)y * g.w + (uint32_t)x;
  const uint8_t b = bits[g.off + n / 2];
  return (n & 1) ? (b & 0x0F) : (b >> 4);
}

// The width of s in pixels.
inline int aaWidth(const AaFont& f, const char* s) {
  int w = 0;
  for (int i = 0; s[i];) w += f.glyphs[aaIndex(aaNext(s, &i))].adv;
  return w;
}

// How many bytes of s fit in w pixels (never in the middle of a UTF-8 sequence).
inline int aaFitBytes(const AaFont& f, const char* s, int w) {
  int x = 0, i = 0;
  while (s[i]) {
    int j = i;
    const int adv = f.glyphs[aaIndex(aaNext(s, &j))].adv;
    if (x + adv > w) break;
    x += adv; i = j;
  }
  return i;
}

// bg and fg mixed by a coverage of a/15 (RGB565).
inline uint16_t aaBlend565(uint16_t bg, uint16_t fg, uint8_t a) {
  if (a == 0) return bg;
  if (a >= 15) return fg;
  const int r = ((bg >> 11) & 31) * (15 - a) + ((fg >> 11) & 31) * a;
  const int g = ((bg >> 5) & 63) * (15 - a) + ((fg >> 5) & 63) * a;
  const int b = (bg & 31) * (15 - a) + (fg & 31) * a;
  return (uint16_t)(((r + 7) / 15) << 11 | ((g + 7) / 15) << 5 | ((b + 7) / 15));
}
